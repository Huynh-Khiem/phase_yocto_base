/dts-v1/;
/plugin/;

/ {
	compatible = "brcm,bcm2711", "brcm,bcm2835";

	fragment@0 {
		target = <&gpio>;
		__overlay__ {
			pir_pins: pir_pins {
				brcm,pins = <17>;        /* GPIO17 */
				brcm,function = <0>;     /* 0 = Input */
				brcm,pull = <1>;         /* 1 = Pull-down */
			};
		};
	};

	fragment@1 {
		target-path = "/";
		__overlay__ {
			pir_sensor: pir_sensor {
				compatible = "khiem,pir-sensor";
				pinctrl-names = "default";
				pinctrl-0 = <&pir_pins>;
				gpios = <&gpio 17 0>;    /* GPIO17, Active High */
				debounce-ms = <150>;
				status = "okay";
			};
		};
	};
};
