## camera/meta-rtsp-camera/conf/layer.conf
```bitbake
BBPATH .= ":${LAYERDIR}"
BBFILES += "${LAYERDIR}/recipes-*/*/*.bb"

BBFILE_COLLECTIONS += "rtsp-camera"
BBFILE_PATTERN_rtsp-camera = "^${LAYERDIR}/"
BBFILE_PRIORITY_rtsp-camera = "6"
LAYERSERIES_COMPAT_rtsp-camera = "kirkstone"
LAYERDEPENDS_rtsp-camera = "core raspberrypi openembedded-layer meta-python networking-layer"
```

## meta-attendance-system/conf/layer.conf
```bitbake
BBPATH .= ":${LAYERDIR}"
BBFILES += "${LAYERDIR}/recipes-*/*/*.bb \
            ${LAYERDIR}/recipes-*/*/*.bbappend"

BBFILE_COLLECTIONS += "attendance-system"
BBFILE_PATTERN_attendance-system = "^${LAYERDIR}/"
BBFILE_PRIORITY_attendance-system = "6"
LAYERDEPENDS_attendance-system = "core attendance rtsp-camera meta-pir meta-tft"
LAYERSERIES_COMPAT_attendance-system = "kirkstone"
```

## meta-attendance-web/conf/layer.conf
```bitbake
BBPATH .= ":${LAYERDIR}"
BBFILES += "${LAYERDIR}/recipes-*/*/*.bb"

BBFILE_COLLECTIONS += "attendance-web"
BBFILE_PATTERN_attendance-web = "^${LAYERDIR}/"
BBFILE_PRIORITY_attendance-web = "6"
LAYERDEPENDS_attendance-web = "core attendance-system"
LAYERSERIES_COMPAT_attendance-web = "kirkstone"
```

## meta-attendance/conf/layer.conf
```bitbake
BBPATH .= ":${LAYERDIR}"
BBFILES += "${LAYERDIR}/recipes-*/*/*.bb"

BBFILE_COLLECTIONS += "attendance"
BBFILE_PATTERN_attendance = "^${LAYERDIR}/"
BBFILE_PRIORITY_attendance = "6"
LAYERDEPENDS_attendance = "core rtsp-camera"
LAYERSERIES_COMPAT_attendance = "kirkstone"
```

## meta-pir/conf/layer.conf
```bitbake
BBPATH .= ":${LAYERDIR}"

BBFILES += "${LAYERDIR}/recipes-*/*/*.bb \
            ${LAYERDIR}/recipes-*/*/*.bbappend"

BBFILE_COLLECTIONS += "meta-pir"
BBFILE_PATTERN_meta-pir = "^${LAYERDIR}/"
BBFILE_PRIORITY_meta-pir = "6"

LAYERDEPENDS_meta-pir = "core raspberrypi"
LAYERSERIES_COMPAT_meta-pir = "kirkstone"
```

## tft-yocto-kirkstone/meta-tft/conf/layer.conf
```bitbake
BBPATH .= ":${LAYERDIR}"

BBFILES += "${LAYERDIR}/recipes-*/*/*.bb \
            ${LAYERDIR}/recipes-*/*/*.bbappend"

BBFILE_COLLECTIONS += "meta-tft"
BBFILE_PATTERN_meta-tft = "^${LAYERDIR}/"
BBFILE_PRIORITY_meta-tft = "6"

LAYERDEPENDS_meta-tft = "core raspberrypi"
LAYERSERIES_COMPAT_meta-tft = "kirkstone"
```
